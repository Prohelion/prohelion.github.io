VERSION ""

NS_ :

BS_:

BU_: Sensor

BO_ 256 Temperature: 8 Sensor
 SG_ Value : 0|16@1+ (0.1,0) [0|150] "C" Vector__XXX
